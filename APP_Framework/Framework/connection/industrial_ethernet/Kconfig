## APP_Framework/Framework/connection/industrial_ethernet/Kconfig
```kconfig
config CONNECTION_ADAPTER_ETHERCAT
    bool "Using ethercat on industrial_ethernet adapter device"
    default n

    if CONNECTION_ADAPTER_ETHERCAT
        source "$APP_DIR/Framework/connection/industrial_ethernet/ethercat/Kconfig"
    endif

menuconfig POWERLINK_MN
    bool "Using powerlink MN"
    default n

menuconfig POWERLINK_CN
    bool "Using powerlink CN"
    default n
```
